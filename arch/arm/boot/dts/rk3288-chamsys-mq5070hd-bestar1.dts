// SPDX-License-Identifier: (GPL-2.0+ OR MIT)
/*
 * Device tree file for ChamSys Ltd MQ50HD and MQ70HD
 * with new Bestar internal screen.
 */

/dts-v1/;
#include "rk3288-chamsys-mq5070hd.dtsi"

/ {
	model = "ChamSys-RK3288-MQ5070HD-bestar1";
};

&panel {
	compatible = "bestar,bsd101wum-n80";
};

&panel_touch {
	touchscreen-inverted-x = <1>;
	touchscreen-inverted-y = <1>;
};
